## main/Kconfig
```kconfig
menu "Blackmagic-ESP32S3 Hardware"

    choice BOARD
        prompt "Board"
        default BOARD_TDISPLAY_S3_AMOLED

        config BOARD_TDISPLAY_S3_AMOLED
            bool
            prompt "T-Display S3 AMOLED"
            select CONFIG_SPIRAM
            select CONFIG_SPIRAM_MODE_OCT
            select CONFIG_SPIRAM_TYPE_AUTO
            select CONFIG_SPIRAM_ALLOW_STACK_EXTERNAL_MEMORY
            select CONFIG_SPIRAM_SPEED_80M
            select CONFIG_SPIRAM_USE_MALLOC
            select CONFIG_SPIRAM_MEMTEST
            select CONFIG_SPIRAM_TRY_ALLOCATE_WIFI_LWIP
            select CONFIG_SPIRAM_ALLOW_BSS_SEG_EXTERNAL_MEMORY
            select RM67162_GRAPHICS

        config BOARD_CARDPUTER
            bool
            prompt "M5Stack Cardputer"
            select ST7789_GRAPHICS
            select CARDPUTER_KEYBOARD

    endchoice

    config RM67162_GRAPHICS
        bool
        prompt "RM67162 Graphics"
        depends on BOARD_TDISPLAY_S3_AMOLED

    config ST7789_GRAPHICS
        bool
        prompt "ST7789 Graphics (Cardputer)"
        depends on BOARD_CARDPUTER

    config CARDPUTER_KEYBOARD
        bool
        prompt "Cardputer IO-matrix keyboard"
        depends on BOARD_CARDPUTER

endmenu
```
